## drivers/rtc/Kconfig.ds3231
```kconfig
# Copyright (c) 2019 Peter Bigot Consulting, LLC
# Modified by Gergo Vari
#
# SPDX-License-Identifier: Apache-2.0
#

config RTC_DS3231
	bool "Maxim DS3231 RTC/TCXO"
	default y
	depends on DT_HAS_MAXIM_DS3231_ENABLED
	depends on I2C
	depends on RTC
	select POLL
	select NOTIFY
	help
	  Enable RTC driver based on Maxim DS3231 I2C device.
```
